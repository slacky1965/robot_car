## sdkconfig.defaults
```kconfig
CONFIG_PARTITION_TABLE_CUSTOM=y
CONFIG_PARTITION_TABLE_CUSTOM_FILENAME="partitions_robot_car.csv"
CONFIG_PARTITION_TABLE_FILENAME="partitions_robot_car.csv"
#CONFIG_ESP32_SPIRAM_SUPPORT=y
#CONFIG_SPIRAM_IGNORE_NOTFOUND=y
CONFIG_ESPTOOLPY_FLASHSIZE_4MB=y
CONFIG_ESPTOOLPY_FLASHSIZE="4MB"
CONFIG_LOG_DEFAULT_LEVEL_ERROR=y
CONFIG_LOG_DEFAULT_LEVEL=1
CONFIG_HTTPD_MAX_REQ_HDR_LEN=2048
CONFIG_FATFS_CODEPAGE_437=y
CONFIG_FATFS_CODEPAGE=437
CONFIG_FATFS_LFN_HEAP=y
CONFIG_FATFS_MAX_LFN=255
CONFIG_MBEDTLS_CERTIFICATE_BUNDLE=n
```
